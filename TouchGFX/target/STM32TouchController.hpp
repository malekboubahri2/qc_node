/* USER CODE BEGIN Header */
/**
  ******************************************************************************
  * File Name          : STM32TouchController.hpp
  ******************************************************************************
  * This file is generated by TouchGFX Generator 4.19.1.
  ******************************************************************************
  * @attention
  *
  * Copyright (c) 2022 STMicroelectronics.
  * All rights reserved.
  *
  * This software is licensed under terms that can be found in the LICENSE file
  * in the root directory of this software component.
  * If no LICENSE file comes with this software, it is provided AS-IS.
  *
  ******************************************************************************
  */
/* USER CODE END Header */

/* USER CODE BEGIN STM32TouchController */

#ifndef STM32TOUCHCONTROLLER_HPP
#define STM32TOUCHCONTROLLER_HPP

#include <platform/driver/touch/TouchController.hpp>

// GT911 specific defines
#define GT911_ID_REG ((uint16_t)0x8140)
#define GT911_ID ((uint8_t)0x39)

#define GT911_TOUCH_POS_REG ((uint16_t)0x8150)
#define GT911_STATUS_REG ((uint16_t)0x814E)
#define GT911_I2C_ADDR ((uint8_t)0xBA)
#define GT911_REG_BYTES ((uint8_t)2)
#define GT911_TOUCH_MSB_MASK ((uint8_t)0xFF)
#define GT911_STATUS_MASK ((uint8_t)0x0F)

#define FT5336_TOUCH_POS_REG ((uint16_t)0x0003)
#define FT5336_STATUS_REG ((uint16_t)0x0002)
#define FT5336_I2C_ADDR ((uint8_t)0x70)
#define FT5336_REG_BYTES ((uint8_t)1)
#define FT5336_TOUCH_MSB_MASK ((uint8_t)0x07)
#define FT5336_STATUS_MASK ((uint8_t)0x07)

/**
 * @class STM32TouchController
 *
 * @brief This class specializes TouchController Interface.
 *
 * @sa touchgfx::TouchController
 */

class STM32TouchController : public touchgfx::TouchController
{
public:

    STM32TouchController() {}

    /**
      * @fn virtual void STM32TouchController::init() = 0;
      *
      * @brief Initializes touch controller.
      *
      *        Initializes touch controller.
      */
    virtual void init();

    /**
    * @fn virtual bool STM32TouchController::sampleTouch(int32_t& x, int32_t& y) = 0;
    *
    * @brief Checks whether the touch screen is being touched, and if so, what coordinates.
    *
    *        Checks whether the touch screen is being touched, and if so, what coordinates.
    *
    * @param [out] x The x position of the touch
    * @param [out] y The y position of the touch
    *
    * @return True if a touch has been detected, otherwise false.
    */
    virtual bool sampleTouch(int32_t& x, int32_t& y);
};
#endif // STM32TOUCHCONTROLLER_HPP

/* USER CODE END STM32TouchController */

/************************ (C) COPYRIGHT STMicroelectronics *****END OF FILE****/
